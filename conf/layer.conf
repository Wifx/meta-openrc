## conf/layer.conf
```bitbake
# We have a conf and classes directory, append to BBPATH
BBPATH .= ":${LAYERDIR}"

# We have a recipes directory, add to BBFILES
BBFILES += "${LAYERDIR}/recipes-*/*/*.bb ${LAYERDIR}/recipes-*/*/*.bbappend"

BBFILE_COLLECTIONS += "openrc"
BBFILE_PATTERN_openrc := "^${LAYERDIR}/"
BBFILE_PRIORITY_openrc = "7"

# Override default values in openrc-native.bbclass
OPENRC_INITDIR = "${sysconfdir}/openrc.d"
OPENRC_CONFDIR = "${sysconfdir}/conf.d"

PREFERRED_RPROVIDER_sysvinit-pidof = "openrc-sysvinit"

LAYERSERIES_COMPAT_openrc = "kirkstone"
```
